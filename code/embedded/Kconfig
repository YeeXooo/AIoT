## code/embedded/Kconfig
```kconfig
config LDR_ADC_CHANNEL
    int
    prompt "set the ldr."
    default 5
    depends on ENABLE_VEHICLE_SAFETY

config BEEP_PIN
    int "Beep pin"
    default 0
    depends on ENABLE_VEHICLE_SAFETY

config LED_RED_PIN
    int "Red LED pin"
    default 3
    depends on ENABLE_VEHICLE_SAFETY

config LED_GREEN_PIN
    int "Green LED pin"
    default 9
    depends on ENABLE_VEHICLE_SAFETY

config LED_YELLOW_PIN
    int "Yellow LED pin"
    default 12
    depends on ENABLE_VEHICLE_SAFETY

config UART_RX
    int
    prompt "set the B2."
    default 7
    depends on ENABLE_VEHICLE_SAFETY

config UART_TX
    int
    prompt "set the B3."
    default 8
    depends on ENABLE_VEHICLE_SAFETY
```
